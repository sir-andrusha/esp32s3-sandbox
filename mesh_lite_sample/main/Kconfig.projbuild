## mesh_lite_sample/main/Kconfig.projbuild
```kconfig
menu "Example Configuration"

config ROUTER_SSID
    string "Router SSID"
        default "ROUTER_SSID"
        help
            Router SSID.

config ROUTER_PASSWORD
    string "Router password"
        default "ROUTER_PASSWORD"
        help
            Router password.

config SERVER_IP
    string "Server IP address"
        default "192.168.0.1"
        help
            Server IP address.

config SERVER_PORT
    int "Server port"
        default "8070"
        help
            Server port.

config EXAMPLE_WEB_MOUNT_POINT
    string "Website mount point in VFS"
    default "/www"
    help
        Specify the mount point in VFS.

config EXAMPLE_MDNS_HOST_NAME
    string "mDNS Host Name"
    default "esp-home"
    help
        Specify the domain name used in the mDNS service.
        Note that webpage also take it as a part of URL where it will send GET/POST requests to.
    
        choice EXAMPLE_WEB_DEPLOY_MODE
            prompt "Website deploy mode"
            default EXAMPLE_WEB_DEPLOY_SF
            help
                Select website deploy mode.
                You can deploy website to host, and ESP32 will retrieve them in a semihost way (JTAG is needed).
                You can deploy website to SD card or SPI flash, and ESP32 will retrieve them via SDIO/SPI interface.
                Detailed operation steps are listed in the example README file.
            config EXAMPLE_WEB_DEPLOY_SF
                bool "Deploy website to SPI Nor Flash"
                help
                    Deploy website to SPI Nor Flash.
                    Choose this production mode if the size of website is small (less than 2MB).
        endchoice

endmenu
```

## mesh_lite_sample_no_router/main/Kconfig.projbuild
```kconfig
menu "Example Configuration"

    config MESH_ROOT
        select JOIN_MESH_IGNORE_ROUTER_STATUS
        bool "Root device"
        default n
        help
            Configure the root device type.

    config MESH_CHANNEL
        int "Mesh network channel"
        range 1 14
        default 11
        help
            Mesh network channel.

    config BRIDGE_SOFTAP_SSID
        string
        prompt "SoftAP SSID"
        default "br" if !MESH_ROOT
        default "br" if MESH_ROOT
        help
            SSID of ESP-Bridge SoftAP.

    config EXAMPLE_WEB_MOUNT_POINT
        string "Website mount point in VFS"
        default "/www"
        help
            Specify the mount point in VFS.
    
    config EXAMPLE_MDNS_HOST_NAME
        string "mDNS Host Name"
        default "master-drone"
        help
            Specify the domain name used in the mDNS service.
            Note that webpage also take it as a part of URL where it will send GET/POST requests to.
                    
endmenu
```
